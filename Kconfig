## Kconfig
```kconfig
config ZMK_BEHAVIOR_HOLD_TAP_LONG
    bool
    default y
    depends on DT_HAS_ZMK_BEHAVIOR_HOLD_TAP_LONG_ENABLED

if ZMK_BEHAVIOR_HOLD_TAP_LONG

config ZMK_BEHAVIOR_HOLD_TAP_LONG_MAX_HELD
    int "Hold Tap Long Max Held"
    default 10
    help
      Max number of simultaneously held hold-tap-long keys

config ZMK_BEHAVIOR_HOLD_TAP_LONG_MAX_CAPTURED_EVENTS
    int "Hold Tap Long Max Captured Events"
    default 40
    help
      Max number of captured system events while waiting to resolve hold-tap-long keys

endif
```

## dts/bindings/behaviors/zmk,behavior-hold-tap-long.yaml
```yaml
# Hold-tap with a third "long hold" stage.
# bindings = <hold>, <tap>, <long-hold>; hold gets the first parameter,
# tap and long-hold both get the second one.

description: Hold or Tap behavior with a long-hold stage

compatible: "zmk,behavior-hold-tap-long"

include: two_param.yaml

properties:
  bindings:
    type: phandles
    required: true
  tapping-term-ms:
    type: int
    required: true
  long-hold-ms:
    type: int
    required: true
    description: |
      Time from key press after which, if no other key was pressed while holding,
      the hold binding is released and the long-hold binding is pressed.
  quick-tap-ms:
    type: int
    default: -1
  require-prior-idle-ms:
    type: int
    default: -1
  flavor:
    type: string
    required: false
    default: "hold-preferred"
    enum:
      - "hold-preferred"
      - "balanced"
      - "tap-preferred"
      - "tap-unless-interrupted"
  hold-while-undecided:
    type: boolean
  hold-while-undecided-linger:
    type: boolean
  retro-tap:
    type: boolean
  hold-trigger-key-positions:
    type: array
    required: false
    default: []
  hold-trigger-on-release:
    type: boolean
```
